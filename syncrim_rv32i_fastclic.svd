# SyncRim RV32I FASTCLIC register map
Vendor: SyncRim; Series: SyncRim RV32I; File version: 0
RV32I Model equipped with a variant of the CLIC
CPU: RV32I r0p1, little endian, no MPU, no FPU, 8 interrupt priority bits
Address unit: 32 bits
Registers are 32-bit, read-write, reset 0x0 unless marked. A register's access mark holds for its fields unless they carry their own. Offsets are from the block's base; lines under a group give offsets from that group; [hi:lo] are bit positions; {n}, {i} and the like mark numbered series; 'fields as' and 'values as' point back to an identical list; <NAME> marks a mode.

## Memory map
0x00005000 MTIME size 0x10 — Timer Peripheral
0x60000000 GPIO size 0x14 — General Purpose Input/Output

## GPIO — General Purpose Input/Output
Base 0x60000000
0x00 ENABLE — GPIO Pin Enable
0x04 CONFIG — GPIO Pin I/O Config
0x08 INTERRUPT_ENABLE — GPIO Pin Interrupt Enable
0x0C SET wo — GPIO Pin Set
0x10 Clear wo — GPIO Pin Clear
0x14 TOGGLE wo — GPIO Pin Toggle

## MTIME — Timer Peripheral
Base 0x00005000
0x00 MTIME_LO ro — Timer Low 32 bits
0x04 MTIME_HI ro — Timer Hi 32 bits
0x08 MTIME_COMP_LO — Timer Comp Low 32 bits
0x0C MTIME_COMP_HI — Timer Comp Hi 32 bits
